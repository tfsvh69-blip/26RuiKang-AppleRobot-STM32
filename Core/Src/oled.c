/* USER CODE BEGIN Header */
/**
  ******************************************************************************
  * @file    oled.c
  * @brief   SSD1306 OLED显示模块实现 - I2C1 + TX DMA
  ******************************************************************************
  */
/* USER CODE END Header */

/* Includes ------------------------------------------------------------------*/
#include <stdint.h>
#include "oled.h"
#include "i2c.h"
#include "cmsis_os.h"

/* USER CODE BEGIN 0 */

/* SSD1306: 128x64 -> 8 pages, each page 128 bytes */
static uint8_t oled_buffer[OLED_WIDTH * (OLED_HEIGHT / 8u)];

/* OLED I2C地址（初始化时自动探测 0x3C/0x3D） */
static uint16_t oled_i2c_addr = (uint16_t)OLED_I2C_ADDR;

/* DMA发送用的staging buffer（必须是静态/全局，不能用栈变量） */
static uint8_t oled_tx_cmd_buf[1u + 32u];
static uint8_t oled_tx_data_buf[1u + OLED_WIDTH];

static HAL_StatusTypeDef OLED_WriteCommands(const uint8_t *cmds, uint16_t len);
static HAL_StatusTypeDef OLED_WriteData(const uint8_t *data, uint16_t len);
static void OLED_WaitI2CReady(uint32_t timeout_ms);

static void OLED_BufferClear(void);
static void OLED_DrawPixel(uint8_t x, uint8_t y, uint8_t on);
static void OLED_DrawChar8x16(uint8_t x, uint8_t y, char ch);

/* 最小内置8x16字模（行向量：每行1字节，bit7为最左像素）
 * 仅覆盖测试常用字符：空格、0-9、A-Z。
 * 未覆盖字符按空格处理。
 */

typedef struct {
  char ch;
  uint8_t rows[16];
} OLED_Glyph8x16;

static const OLED_Glyph8x16 oled_font_8x16[] = {
  { ' ', {0,0,0,0,0,0,0,0,0,0,0,0,0,0,0,0} },

  /* Digits 0-9 */
  { '0', {0x3C,0x66,0xC3,0xC3,0xC3,0xC3,0xC3,0xC3,0xC3,0xC3,0xC3,0xC3,0xC3,0xC3,0x66,0x3C} },
  { '1', {0x18,0x38,0x78,0x18,0x18,0x18,0x18,0x18,0x18,0x18,0x18,0x18,0x18,0x18,0x18,0x7E} },
  { '2', {0x3C,0x66,0xC3,0x03,0x06,0x0C,0x18,0x30,0x60,0xC0,0xC0,0xC0,0xC0,0xC0,0xFF,0xFF} },
  { '3', {0x7E,0xC3,0x03,0x03,0x06,0x1C,0x06,0x03,0x03,0x03,0x03,0x03,0xC3,0x66,0x3C,0x00} },
  { '4', {0x06,0x0E,0x1E,0x36,0x66,0xC6,0x86,0xFF,0xFF,0x06,0x06,0x06,0x06,0x06,0x06,0x00} },
  { '5', {0xFF,0xFF,0xC0,0xC0,0xFC,0xFE,0x03,0x03,0x03,0x03,0x03,0x03,0xC3,0x66,0x3C,0x00} },
  { '6', {0x3C,0x66,0xC0,0xC0,0xFC,0xFE,0xC3,0xC3,0xC3,0xC3,0xC3,0xC3,0xC3,0x66,0x3C,0x00} },
  { '7', {0xFF,0xFF,0x03,0x06,0x0C,0x18,0x30,0x30,0x60,0x60,0xC0,0xC0,0xC0,0xC0,0xC0,0x00} },
  { '8', {0x3C,0x66,0xC3,0xC3,0x66,0x3C,0x66,0xC3,0xC3,0xC3,0xC3,0xC3,0xC3,0x66,0x3C,0x00} },
  { '9', {0x3C,0x66,0xC3,0xC3,0xC3,0xC3,0xC3,0x7F,0x3F,0x03,0x03,0x03,0x03,0x66,0x3C,0x00} },

  /* Uppercase A-Z (粗略字形，满足测试显示需求) */
  { 'A', {0x18,0x3C,0x66,0x66,0xC3,0xC3,0xFF,0xFF,0xC3,0xC3,0xC3,0xC3,0xC3,0xC3,0xC3,0x00} },
  { 'B', {0xFC,0xFE,0xC3,0xC3,0xFE,0xFC,0xC3,0xC3,0xC3,0xC3,0xC3,0xC3,0xFE,0xFC,0x00,0x00} },
  { 'C', {0x3C,0x66,0xC3,0xC0,0xC0,0xC0,0xC0,0xC0,0xC0,0xC0,0xC0,0xC3,0x66,0x3C,0x00,0x00} },
  { 'D', {0xF8,0xFC,0xCE,0xC7,0xC3,0xC3,0xC3,0xC3,0xC3,0xC3,0xC3,0xC7,0xCE,0xFC,0xF8,0x00} },
  { 'E', {0xFF,0xFF,0xC0,0xC0,0xFE,0xFE,0xC0,0xC0,0xC0,0xC0,0xC0,0xC0,0xFF,0xFF,0x00,0x00} },
  { 'F', {0xFF,0xFF,0xC0,0xC0,0xFE,0xFE,0xC0,0xC0,0xC0,0xC0,0xC0,0xC0,0xC0,0xC0,0x00,0x00} },
  { 'G', {0x3C,0x66,0xC3,0xC0,0xC0,0xC0,0xCF,0xCF,0xC3,0xC3,0xC3,0xC3,0x67,0x3F,0x00,0x00} },
  { 'H', {0xC3,0xC3,0xC3,0xC3,0xFF,0xFF,0xC3,0xC3,0xC3,0xC3,0xC3,0xC3,0xC3,0xC3,0x00,0x00} },
  { 'I', {0x7E,0x7E,0x18,0x18,0x18,0x18,0x18,0x18,0x18,0x18,0x18,0x18,0x7E,0x7E,0x00,0x00} },
  { 'J', {0x1F,0x1F,0x06,0x06,0x06,0x06,0x06,0x06,0x06,0x06,0xC6,0xC6,0x7C,0x38,0x00,0x00} },
  { 'K', {0xC3,0xC6,0xCC,0xD8,0xF0,0xE0,0xF0,0xD8,0xCC,0xC6,0xC3,0xC3,0xC3,0xC3,0x00,0x00} },
  { 'L', {0xC0,0xC0,0xC0,0xC0,0xC0,0xC0,0xC0,0xC0,0xC0,0xC0,0xC0,0xC0,0xFF,0xFF,0x00,0x00} },
  { 'M', {0xC3,0xE7,0xFF,0xDB,0xDB,0xC3,0xC3,0xC3,0xC3,0xC3,0xC3,0xC3,0xC3,0xC3,0x00,0x00} },
  { 'N', {0xC3,0xE3,0xF3,0xDB,0xCF,0xC7,0xC3,0xC3,0xC3,0xC3,0xC3,0xC3,0xC3,0xC3,0x00,0x00} },
  { 'O', {0x3C,0x66,0xC3,0xC3,0xC3,0xC3,0xC3,0xC3,0xC3,0xC3,0xC3,0xC3,0xC3,0x66,0x3C,0x00} },
  { 'P', {0xFC,0xFE,0xC3,0xC3,0xC3,0xFE,0xFC,0xC0,0xC0,0xC0,0xC0,0xC0,0xC0,0xC0,0x00,0x00} },
  { 'Q', {0x3C,0x66,0xC3,0xC3,0xC3,0xC3,0xC3,0xC3,0xC3,0xC3,0xDB,0xCF,0x7E,0x3C,0x0F,0x00} },
  { 'R', {0xFC,0xFE,0xC3,0xC3,0xC3,0xFE,0xFC,0xD8,0xCC,0xC6,0xC3,0xC3,0xC3,0xC3,0x00,0x00} },
  { 'S', {0x3E,0x63,0xC0,0xC0,0x70,0x3C,0x0E,0x03,0x03,0x03,0x03,0xC3,0x66,0x3C,0x00,0x00} },
  { 'T', {0xFF,0xFF,0x18,0x18,0x18,0x18,0x18,0x18,0x18,0x18,0x18,0x18,0x18,0x18,0x00,0x00} },
  { 'U', {0xC3,0xC3,0xC3,0xC3,0xC3,0xC3,0xC3,0xC3,0xC3,0xC3,0xC3,0xC3,0x66,0x3C,0x00,0x00} },
  { 'V', {0xC3,0xC3,0xC3,0xC3,0xC3,0xC3,0x66,0x66,0x66,0x3C,0x3C,0x18,0x18,0x00,0x00,0x00} },
  { 'W', {0xC3,0xC3,0xC3,0xC3,0xDB,0xDB,0xDB,0xDB,0xFF,0xFF,0xE7,0xC3,0xC3,0xC3,0x00,0x00} },
  { 'X', {0xC3,0x66,0x66,0x3C,0x18,0x18,0x3C,0x66,0x66,0xC3,0xC3,0xC3,0x00,0x00,0x00,0x00} },
  { 'Y', {0xC3,0x66,0x66,0x3C,0x18,0x18,0x18,0x18,0x18,0x18,0x18,0x18,0x18,0x18,0x00,0x00} },
  { 'Z', {0xFF,0xFF,0x06,0x0C,0x18,0x30,0x60,0xC0,0xC0,0xC0,0xC0,0xC0,0xFF,0xFF,0x00,0x00} },
};

static const OLED_Glyph8x16 *OLED_FindGlyph(char ch)
{
  uint32_t i;
  for (i = 0; i < (sizeof(oled_font_8x16) / sizeof(oled_font_8x16[0])); i++)
  {
    if (oled_font_8x16[i].ch == ch)
      return &oled_font_8x16[i];
  }
  return &oled_font_8x16[0];
}

/* USER CODE END 0 */

HAL_StatusTypeDef OLED_Init(void)
{
  /* 典型SSD1306初始化序列（参考你提供的示例） */
  static const uint8_t init_cmds[] = {
    0xAE,       /* display off */
    0xD5, 0x80, /* clock divide */
    0xA8, 0x3F, /* multiplex */
    0xD3, 0x00, /* display offset */
    0x40,       /* start line */
    0xA1,       /* segment remap */
    0xC8,       /* COM scan dir */
    0xDA, 0x12, /* COM pins */
    0x81, 0xCF, /* contrast */
    0xD9, 0xF1, /* pre-charge */
    0xDB, 0x30, /* vcomh */
    0xA4,       /* output follows RAM */
    0xA6,       /* normal display */
    0x8D, 0x14, /* charge pump */
    0xAF        /* display on */
  };

  OLED_WaitI2CReady(100);

  /* 先探测器件是否应答，避免后续DMA一直busy导致任务卡住 */
  oled_i2c_addr = (uint16_t)OLED_I2C_ADDR;
  if (HAL_I2C_IsDeviceReady(&hi2c1, oled_i2c_addr, 2, 100) != HAL_OK)
  {
    /* 兼容部分模块使用0x3D地址 */
    oled_i2c_addr = (uint16_t)(0x3Du << 1);
    if (HAL_I2C_IsDeviceReady(&hi2c1, oled_i2c_addr, 2, 100) != HAL_OK)
      return HAL_ERROR;
  }

  if (OLED_WriteCommands(init_cmds, (uint16_t)sizeof(init_cmds)) != HAL_OK)
    return HAL_ERROR;

  OLED_BufferClear();
  return OLED_Update();
}

HAL_StatusTypeDef OLED_Clear(void)
{
  OLED_BufferClear();
  return OLED_Update();
}

HAL_StatusTypeDef OLED_ClearBuffer(void)
{
  OLED_BufferClear();
  return HAL_OK;
}

HAL_StatusTypeDef OLED_Flush(void)
{
  return OLED_Update();
}

HAL_StatusTypeDef OLED_Update(void)
{
  HAL_StatusTypeDef st;
  uint8_t page;

  for (page = 0; page < (OLED_HEIGHT / 8u); page++)
  {
    uint8_t set_pos[] = {
      (uint8_t)(0xB0u | page), /* page */
      0x10u,                   /* high column = 0 */
      0x00u                    /* low column = 0 */
    };

    st = OLED_WriteCommands(set_pos, (uint16_t)sizeof(set_pos));
    if (st != HAL_OK)
      return st;

    st = OLED_WriteData(&oled_buffer[OLED_WIDTH * page], OLED_WIDTH);
    if (st != HAL_OK)
      return st;
  }

  return HAL_OK;
}

HAL_StatusTypeDef OLED_DrawString(uint8_t line, uint8_t column, const char *str)
{
  uint8_t x;
  uint8_t y;
  uint32_t i;

  if (str == NULL)
    return HAL_ERROR;
  if (line < 1 || line > OLED_TEXT_LINES)
    return HAL_ERROR;
  if (column < 1 || column > OLED_TEXT_COLUMNS)
    return HAL_ERROR;

  x = (uint8_t)((column - 1u) * 8u);
  y = (uint8_t)((line - 1u) * 16u);

  for (i = 0; str[i] != '\0'; i++)
  {
    if ((uint32_t)(x + 8u) > OLED_WIDTH)
      break;

    OLED_DrawChar8x16(x, y, str[i]);
    x = (uint8_t)(x + 8u);
  }

  return HAL_OK;
}

HAL_StatusTypeDef OLED_ShowString(uint8_t line, uint8_t column, const char *str)
{
  HAL_StatusTypeDef st;
  st = OLED_DrawString(line, column, str);
  if (st != HAL_OK)
    return st;
  return OLED_Update();
}

HAL_StatusTypeDef OLED_DrawNum(uint8_t line, uint8_t column, uint32_t num, uint8_t len)
{
  char buf[11];
  int8_t i;

  if (len < 1 || len > 10)
    return HAL_ERROR;

  for (i = (int8_t)len - 1; i >= 0; i--)
  {
    buf[i] = (char)('0' + (num % 10u));
    num /= 10u;
  }
  buf[len] = '\0';

  /* 左侧空格填充：当高位为0且非最后一位时显示空格 */
  for (i = 0; i < (int8_t)len - 1; i++)
  {
    if (buf[i] == '0')
      buf[i] = ' ';
    else
      break;
  }

  return OLED_DrawString(line, column, buf);
}

HAL_StatusTypeDef OLED_ShowNum(uint8_t line, uint8_t column, uint32_t num, uint8_t len)
{
  HAL_StatusTypeDef st;
  st = OLED_DrawNum(line, column, num, len);
  if (st != HAL_OK)
    return st;
  return OLED_Update();
}

/* ---------------------- internal helpers ---------------------- */

static HAL_StatusTypeDef OLED_WriteCommands(const uint8_t *cmds, uint16_t len)
{
  HAL_StatusTypeDef st;
  uint16_t i;

  if (cmds == NULL || len == 0)
    return HAL_ERROR;

  /* init/cursor命令都很短，限制len <= 32 */
  if (len > 32u)
    return HAL_ERROR;

  oled_tx_cmd_buf[0] = 0x00u; /* control byte: commands */
  for (i = 0; i < len; i++)
    oled_tx_cmd_buf[1u + i] = cmds[i];

  OLED_WaitI2CReady(100);
  st = HAL_I2C_Master_Transmit_DMA(&hi2c1, oled_i2c_addr, oled_tx_cmd_buf, (uint16_t)(1u + len));
  if (st != HAL_OK)
    return st;

  OLED_WaitI2CReady(100);
  if (HAL_I2C_GetState(&hi2c1) != HAL_I2C_STATE_READY)
    return HAL_TIMEOUT;
  return HAL_OK;
}

static HAL_StatusTypeDef OLED_WriteData(const uint8_t *data, uint16_t len)
{
  HAL_StatusTypeDef st;
  uint16_t i;

  if (data == NULL || len == 0)
    return HAL_ERROR;

  /* 本驱动按page写，期望len == 128 */
  if (len > OLED_WIDTH)
    return HAL_ERROR;

  oled_tx_data_buf[0] = 0x40u; /* control byte: data */
  for (i = 0; i < len; i++)
    oled_tx_data_buf[1u + i] = data[i];

  OLED_WaitI2CReady(100);
  st = HAL_I2C_Master_Transmit_DMA(&hi2c1, oled_i2c_addr, oled_tx_data_buf, (uint16_t)(1u + len));
  if (st != HAL_OK)
    return st;

  OLED_WaitI2CReady(100);
  if (HAL_I2C_GetState(&hi2c1) != HAL_I2C_STATE_READY)
    return HAL_TIMEOUT;
  return HAL_OK;
}

static void OLED_WaitI2CReady(uint32_t timeout_ms)
{
  uint32_t start = HAL_GetTick();

  while (HAL_I2C_GetState(&hi2c1) != HAL_I2C_STATE_READY)
  {
    if ((HAL_GetTick() - start) > timeout_ms)
      break;

    /* RTOS运行时避免HAL_Delay忙等占CPU */
    if (osKernelGetState() == osKernelRunning)
      osDelay(1);
    else
      HAL_Delay(1);
  }
}

static void OLED_BufferClear(void)
{
  uint32_t i;
  for (i = 0; i < sizeof(oled_buffer); i++)
    oled_buffer[i] = 0x00u;
}

static void OLED_DrawPixel(uint8_t x, uint8_t y, uint8_t on)
{
  uint16_t index;
  uint8_t mask;

  if (x >= OLED_WIDTH || y >= OLED_HEIGHT)
    return;

  index = (uint16_t)(x + (uint16_t)(y / 8u) * OLED_WIDTH);
  mask = (uint8_t)(1u << (y % 8u));

  if (on)
    oled_buffer[index] |= mask;
  else
    oled_buffer[index] &= (uint8_t)~mask;
}

static void OLED_DrawChar8x16(uint8_t x, uint8_t y, char ch)
{
  const OLED_Glyph8x16 *g;
  uint8_t row;
  uint8_t col;

  if ((uint32_t)x + 8u > OLED_WIDTH || (uint32_t)y + 16u > OLED_HEIGHT)
    return;

  /* 只支持大写字母/数字/空格；小写自动转大写 */
  if (ch >= 'a' && ch <= 'z')
    ch = (char)(ch - 'a' + 'A');

  g = OLED_FindGlyph(ch);

  for (row = 0; row < 16u; row++)
  {
    uint8_t bits = g->rows[row];
    for (col = 0; col < 8u; col++)
    {
      uint8_t on = (uint8_t)((bits & (uint8_t)(0x80u >> col)) ? 1u : 0u);
      OLED_DrawPixel((uint8_t)(x + col), (uint8_t)(y + row), on);
    }
  }
}

/* USER CODE BEGIN 2 */

/* USER CODE END 2 */
